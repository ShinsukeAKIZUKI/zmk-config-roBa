## config/west.yml
```yaml
manifest:
  remotes:
    - name: zmkfirmware
      url-base: https://github.com/zmkfirmware
    - name: kumamuk-git
      url-base: https://github.com/kumamuk-git

  projects:
    - name: zmk
      remote: zmkfirmware
      revision: abb64ba
      import: app/west.yml

    - name: zmk-pmw3610-driver
      remote: kumamuk-git
      revision: 5e04553

  self:
    path: config
```
